/*
 * SGM SGM41606S charger driver by Allen
 slave address:0x65/0x66/0x67 Please refer to the datasheet for details:
Table 6. I2C Address and Mode Selection
 *
 * Copyright (C) 2021 SGMicro Corporation
 *
 */

&i2c11{
	status = "okay";
	clock-frequency = <1000000>;
	sgm41606S: sgm41606S@65 {
		status = "okay";
		compatible = "sgm,sgm41606S-standalone";
		reg = <0x65>;
		sgm41606S,intr_gpio = <&pio 12 IRQ_TYPE_EDGE_FALLING>;

		charger_name = "primary_dvchg";
		charger_name_v4_19 = "primary_divider_chg";
		sgm,sgm41606S,vbat-ovp-dis = <0>;
		sgm,sgm41606S,vbat-ovp = <120>;			//3.5V+ BATOVP [6:0]*0.01V
		sgm,sgm41606S,vbat-ovp-alm-dis = <0>;
		sgm,sgm41606S,vbat-ovp-alm = <110>;		//3.5V+ BATOVP [6:0]*0.01V
		sgm,sgm41606S,ibat-ocp-dis = <0>;
		sgm,sgm41606S,ibat-ocp = <80>; 			//BATOCP < 8.5A,[6:0]*0.1A;>8.5A,8.5A+(BATOCP[6:0]-1010101b) *0.3A
		sgm,sgm41606S,ibat-ocp-alm-dis = <0>;
		sgm,sgm41606S,ibat-ocp-alm = <79>; 		//BATOCP < 8.5A,[6:0]*0.1A;>8.5A,8.5A+(BATOCP[6:0]-1010101b) *0.3A
		sgm,sgm41606S,ibat-ucp-alm-dis = <0>;
		sgm,sgm41606S,ibat-ucp-alm = <1>;		/*0~4.5A,BATUCP_ALM[6:0]*0.05A*/
		sgm,sgm41606S,vbus-ovp = <80>; 			// 7V+BUSOVP[6:0]*0.05V  7V(0000000) – 12.75V(1110011)
		sgm,sgm41606S,vbus-ovp-alm-dis = <0>;
		sgm,sgm41606S,vbus-ovp-alm = <76>;
		sgm,sgm41606S,ibus-ocp = <12>; 		// 1A+BUSOCP[4:0]*0.25A ,1A (00000) – 6.5A (10110)
		sgm,sgm41606S,ibus-ocp-alm-dis = <0>;
		sgm,sgm41606S,ibus-ocp-alm = <11>;
		sgm,sgm41606S,ibus-ucp-alm = <5>;
		sgm,sgm41606S,ibus-ucp-alm-dis = <0>;
		sgm,sgm41606S,ibus-ucp = <1>;  			// 0:rise 500,fall 250;1:rise 250,fall 125
		sgm,sgm41606S,vac-ovp = <2>;			//000 = 6.5V,001 = 10.5V,010 = 12V,011 = 14V,100 = 16V,101 = 18V
		sgm,sgm41606S,vbus-low-dis = <0>;
		sgm,sgm41606S,vbus-high-dis = <0>;
		sgm,sgm41606S,fsw-set = <4>;			/*0:187.5kHz 1:250 2:300 3:375 4:500 5:750 6:1000 7:1500*/
		sgm,sgm41606S,wdt-dis = <1>;
		sgm,sgm41606S,wd-timeout = <3>;			/*0:0.5s 1:1s 2:2s 3:5s 4:10s 5:20s 6:40s 7:80s*/
		sgm,sgm41606S,chg-en = <0>;
		sgm,sgm41606S,mode = <0>;				/*0:off 1:bypass */
		sgm,sgm41606S,tdie-dis = <1>;
		sgm,sgm41606S,tsbus-flt-dis = <1>;
		sgm,sgm41606S,tsbat-flt-dis = <1>;
    };
 };
