// SPDX-License-Identifier: GPL-2.0
/*
 * Copyright (c) 2022 MediaTek Inc.
 */
/********************************************
 * MT6985 MSDC DTSI File
 ********************************************/
#include <dt-bindings/gpio/gpio.h>

&mmc1 {
	host-index = <1>;
	status = "okay";
	bus-width = <4>;
	max-frequency = <200000000>;
	non-removable;
	cap-mmc-highspeed;
	no-sd;
	no-sdio;
};

&mmc2 {
	host-index = <2>;
	status = "disabled";
	bus-width = <4>;
	max-frequency = <200000000>;
	non-removable;
	cap-sd-highspeed;
	sd-uhs-sdr12;
	sd-uhs-sdr25;
	sd-uhs-sdr50;
	sd-uhs-sdr104;
	sd-uhs-ddr50;
	no-mmc;
	no-sd;
	cap-sdio-irq;
};
