// SPDX-License-Identifier: (GPL-2.0 OR MIT)
/*
 * Copyright (C) 2023 MediaTek Inc.
 * Author: Owen Chen <owen.chen@mediatek.com>
 */

&clkitg {
	status = "okay";
	bring-up@0 {
		compatible = "mediatek,clk-bring-up";
		reg = <0>;
		clocks =
			<&topckgen_clk CLK_TOP_DSP_SEL>,
			<&topckgen_clk CLK_TOP_DPMAIF_MAIN_SEL>,
			<&topckgen_clk CLK_TOP_EMI_INTERFACE_546_SEL>,
			<&topckgen_clk CLK_TOP_SSR_SEJ_SEL>,
			<&topckgen_clk CLK_TOP_MMINFRA_SEL>,
			<&infracfg_ao_clk CLK_IFRAO_RG_SOCSYS_FATB>,
			<&mminfra_config_clk CLK_MMINFRA_SMI>;
	};

	bring-up-pd-isp-vcore@c {
		compatible = "mediatek,scpsys-bring-up";
		reg = <0xc>;
		power-domains = <&scpsys MT6989_POWER_DOMAIN_ISP_VCORE>;
	};

	bring-up-pd-mm-infra@23 {
		compatible = "mediatek,scpsys-bring-up";
		reg = <0x23>;
		power-domains = <&scpsys MT6989_POWER_DOMAIN_MM_INFRA>;
	};
};
