## drivers/misc/mediatek/gzvm/Kconfig
```kconfig
# SPDX-License-Identifier: GPL-2.0-only

config MTK_GZVM
	tristate "GenieZone Hypervisor driver for guest VM operation"
	depends on ARM64
	depends on KVM
	help
	  This is a driver for running guest VMs on MTK GenieZone hypervisor.
	  This driver exports kvm-like interfaces for VMM (e.g., crosvm) in
	  order to operate guest VMs on GenieZone hypervisor.

	  If unsure, say N.
```

## drivers/misc/mediatek/mbraink/Kconfig
```kconfig
config MTK_MBRAINK
	tristate "MTK MBRAINK support"
	help
          MBRAINK is a MediaTek in-house kernel module which can
          communicate with android MBrain.
          Set Y to enable this feature.
          If unsure, Set N to stay with legancy feature.
```

## drivers/misc/mediatek/usb/usb_xhci/Kconfig
```kconfig
# SPDX-License-Identifier: GPL-2.0
#
# USB Host Controller Drivers
#

config USB_XHCI_MTK
	tristate "xHCI support for MediaTek SoCs"
	select MFD_SYSCON
	help
	  Say 'Y' to enable the support for the xHCI host controller
	  found in MediaTek SoCs.
	  If unsure, say N.
```

## drivers/misc/mediatek/wlcdrv/Kconfig
```kconfig
config MTK_WLC
	tristate "MTK workload classifier feature"
	help
	  MTK WLC(Workload Classifier Control) that designed by
	  Mediatek is the PMU control mechanism according to
	  pre-trained PMU event number. Use to do the PMU selection
	  and send IPI to microprocessor for trigger WLC classifier.
```

## drivers/mmc/host/Kconfig
```kconfig
# SPDX-License-Identifier: GPL-2.0-only
#
# MMC/SD host controller drivers
#

comment "MMC/SD/SDIO Host Controller Drivers"

config MMC_DEBUG
    tristate "MMC host drivers debugging"
    depends on MMC != n
    help
      This is an option for use by developers; most people should
      say N here. This enables MMC host driver debugging. And further
      added host drivers please don't invent their private macro for
      debugging.

config MMC_MTK
	tristate "MediaTek SD/MMC Card Interface support"
	depends on HAS_DMA
	depends on COMMON_CLK
	select REGULATOR
	select MMC_CQHCI
	help
	  This selects the MediaTek(R) Secure digital and Multimedia card Interface.
	  If you have a machine with a integrated SD/MMC card reader, say Y or M here.
	  This is needed if support for any SD/SDIO/MMC devices is required.
	  If unsure, say N.

config MMC_MTK_PRO
	tristate "MediaTek SD/MMC Card Proprietary Interface support"
	depends on !MMC_MTK
	help
	  This selects the MediaTek(R) Secure digital and Multimedia card
	  Interface. If you have a machine with a integrated SD/MMC card
	  reader, say Y or M here.

	  If unsure, say N.

config MMC_AUTOK
	tristate "MediaTek SD/MMC Card Auto Calibration support"
	help
	  This selects the MediaTek(R) Secure digital and Multimedia card
	  Online Tune Interface. If you have a controller with this interface,
	  say Y or M here.
	  If unsure, say N.
```

## drivers/net/network/Kconfig
```kconfig
# SPDX-License-Identifier: GPL-2.0-only

config MTK_IPV6MAPV4_DEBUG
	bool "Fix ipv6 map v4 exception due to use after free stack"
	help
	  This option makes it possible to send message with
	  ipv6 map v4 destination address
	  ipv6 map v4 triggered by kasan
	  udp send message and record destination address.
```

## drivers/pci/controller/Kconfig
```kconfig
# SPDX-License-Identifier: GPL-2.0

config PCIE_MEDIATEK_GEN3
	tristate "MediaTek Gen3 PCIe controller"
	depends on ARCH_MEDIATEK || COMPILE_TEST
	depends on PCI_MSI_IRQ_DOMAIN
	help
	  Adds support for PCIe Gen3 MAC controller for MediaTek SoCs.
	  This PCIe controller is compatible with Gen3, Gen2 and Gen1 speed,
	  and support up to 256 MSI interrupt numbers for
	  multi-function devices.

	  Say Y here if you want to enable Gen3 PCIe controller support on
	  MediaTek SoCs.
```

## drivers/pinctrl/mediatek/Kconfig
```kconfig
# SPDX-License-Identifier: GPL-2.0-only
menu "MediaTek pinctrl drivers"
	depends on ARCH_MEDIATEK || COMPILE_TEST

config DEVICE_MODULES_EINT_MTK
	tristate "MediaTek External Interrupt Support"
	depends on PINCTRL_MTK || PINCTRL_MTK_MOORE || DEVICE_MODULES_PINCTRL_MTK_PARIS || COMPILE_TEST
	select GPIOLIB
	select IRQ_DOMAIN
	default y if PINCTRL_MTK || PINCTRL_MTK_MOORE
	default DEVICE_MODULES_PINCTRL_MTK_PARIS

config DEVICE_MODULES_PINCTRL_MTK_V2
	tristate

config DEVICE_MODULES_PINCTRL_MTK_PARIS
	tristate
	depends on OF
	select PINMUX
	select GENERIC_PINCONF
	select GPIOLIB
	select DEVICE_MODULES_EINT_MTK
	select OF_GPIO
	select DEVICE_MODULES_PINCTRL_MTK_V2

config PINCTRL_MT6373
	tristate "Mediatek MT6373 pin control"
	depends on OF
	depends on MFD_MTK_SPMI_PMIC
	select DEVICE_MODULES_PINCTRL_MTK_PARIS
	help
	  This is the pin controller and gpio driver for mediatek
	  mt6373 chipset. It will enable mediatek common v2,
	  paris and eint core driver.
	  Say Y here to enable it.

config DEVICE_MODULES_PINCTRL_MT6779
	tristate "Mediatek MT6779 pin control"
	depends on OF
	depends on ARM64 || COMPILE_TEST
	default ARM64 && ARCH_MEDIATEK
	select DEVICE_MODULES_PINCTRL_MTK_PARIS
	help
	  Say yes here to support pin controller and gpio driver
	  on Mediatek MT6779 SoC.
	  In MTK platform, we support virtual gpio and use it to
	  map specific eint which doesn't have real gpio pin.

config PINCTRL_MT6853
	tristate "Mediatek MT6853 pin control"
	depends on OF || COMPILE_TEST
	select DEVICE_MODULES_PINCTRL_MTK_PARIS

config PINCTRL_MT6873
	tristate "Mediatek MT6873 pin control"
	depends on OF || COMPILE_TEST
	select DEVICE_MODULES_PINCTRL_MTK_PARIS

config PINCTRL_MT6886
	tristate "Mediatek MT6886 pin control"
	depends on OF || COMPILE_TEST
	select DEVICE_MODULES_PINCTRL_MTK_PARIS
	help
	  This is the pin controller and gpio driver for mediatek
	  mt6886 chipset. It will enable mediatek common v2,
	  paris and eint core driver.
	  Say Y here to enable it.

config PINCTRL_MT6983
	tristate "Mediatek MT6983 pin control"
	depends on OF || COMPILE_TEST
	select DEVICE_MODULES_PINCTRL_MTK_PARIS
	help
	  This is the pin controller and gpio driver for mediatek
	  mt6983 chipset. It will enable mediatek common v2,
	  paris and eint core driver.
	  Say Y here to enable it.

config PINCTRL_MT6985
	tristate "Mediatek MT6985 pin control"
	depends on OF || COMPILE_TEST
	select DEVICE_MODULES_PINCTRL_MTK_PARIS
	help
	  This is the pin controller and gpio driver for mediatek
	  mt6985 chipset. It will enable mediatek common v2,
	  paris and eint core driver.
	  Say Y here to enable it.

config PINCTRL_MT8188
	tristate "Mediatek MT8188 pin control"
	depends on OF
	depends on ARM64 || COMPILE_TEST
	select DEVICE_MODULES_PINCTRL_MTK_PARIS

config DEVICE_MODULES_PINCTRL_MT8195
	tristate "Mediatek MT8195 pin control"
	depends on OF
	depends on ARM64 || COMPILE_TEST
	select DEVICE_MODULES_PINCTRL_MTK_PARIS

endmenu
```

## drivers/scsi/Kconfig
```kconfig
config MTK_FIX_SCSI_THREAD_RACING_UPDATE
    bool "fix the uevent racing issue"
    help
      This is a temporary config used for mtk userdebug and eng load to fix
      the ALPS06494900 uevent racing issue. Once the patch be merged to ACK
      and pull to our tree, please revert this. This racing issue due to the
      scsi device init and power on reset uevent both modify the device parent
      kobject length.
```

## drivers/ufs/vendor/Kconfig
```kconfig
config UFS_MEDIATEK_INTERNAL
	bool "Mediatek UFS Internal Features"
	depends on SCSI_UFSHCD
	help
	  UFS features or code block that is kept available internally
	  and should not be upstreamed.

config UFSFEATURE
	bool "UFS feature activate"
	depends on SCSI_UFSHCD
	help
	  UFS feature activate such as hpb, tw and etc.

config UFSHID
	bool "UFS Host Initiated Defrag support"
	depends on SCSI_UFSHCD && UFSFEATURE
	help
	  UFS HID Feature Enable

config UFSHID_POC
	bool "UFSHID_POC test"
	depends on SCSI_UFSHCD && UFSFEATURE && UFSHID
	help
	  UFS HID POC test
	  1. block to enter suspend state
	  2. auto_hibern8 enable/disable (HCI)
	  3. set flag bDefragOperation
	  4. debug msg enable (default : disable)

config UFSHID_DEBUG
	bool "HID Debug Enable"
	depends on SCSI_UFSHCD && UFSFEATURE && UFSHID
	default n
	help
	  UFS HID Debug Enable (for check io stat during trigger)


config UFS_MEDIATEK_MCQ
	bool "Mediatek Proprietary MCQ Support"
	depends on SCSI_UFSHCD && DEVICE_MODULES_SCSI_UFS_MEDIATEK
	help
	  Enable on platform that implemented MediaTek non-standard MCQ.
	  This require Kernel support on mcq vendor hook like in kernel 5.15.
```

## drivers/usb/Kconfig
```kconfig
# SPDX-License-Identifier: GPL-2.0
#
# USB device configuration
#
menuconfig USB_SUPPORT
	bool "USB support"
	depends on HAS_IOMEM
	default y
	help
	  This option adds core support for Universal Serial Bus (USB).
	  You will also need drivers from the following menu to make use of it.

if USB_SUPPORT

config USB
	tristate "Support for Host-side USB"
	depends on USB_ARCH_HAS_HCD
	select GENERIC_ALLOCATOR
	select USB_COMMON
	select NLS  # for UTF-8 strings
	help
	  Universal Serial Bus (USB) is a specification for a serial bus
	  subsystem which offers higher speeds and more features than the
	  traditional PC serial port.  The bus supplies power to peripherals
	  and allows for hot swapping.  Up to 127 USB peripherals can be
	  connected to a single USB host in a tree structure.
	  
	  The USB host is the root of the tree, the peripherals are the
	  leaves and the inner nodes are special USB devices called hubs.
	  Most PCs now have USB host ports, used to connect peripherals
	  such as scanners, keyboards, mice, modems, cameras, disks,
	  flash memory, network links, and printers to the PC.

	  Say Y here if your computer has a host-side USB port and you want
	  to use USB devices.  You then need to say Y to at least one of the
	  Host Controller Driver (HCD) options below.  Choose a USB 1.1
	  controller, such as "UHCI HCD support" or "OHCI HCD support",
	  and "EHCI HCD (USB 2.0) support" except for older systems that
	  do not have USB 2.0 support.  It doesn't normally hurt to select
	  them all if you are not certain.

	  If your system has a device-side USB port, used in the peripheral
	  side of the USB protocol, see the "USB Gadget" framework instead.

	  After choosing your HCD, then select drivers for the USB peripherals
	  you'll be using.  You may want to check out the information provided
	  in <file:Documentation/usb/> and especially the links given in
	  <file:Documentation/usb/usb-help.rst>.

	  To compile this driver as a module, choose M here: the
	  module will be called usbcore.

config USB_PCI
	bool "PCI based USB host interface"
	depends on PCI
	default y
	help
	  Many embedded system SOCs (e.g. freescale T2080) have both
	  PCI and USB modules with the USB module directly controlled by
	  registers and having no relationship to the PCI module.

	  If you have such a device you may say N here and PCI related code
	  will not be built in the USB driver.

if USB

source "$(KCONFIG_EXT_PREFIX)drivers/usb/host/Kconfig"

endif

source "$(KCONFIG_EXT_PREFIX)drivers/usb/mtu3/Kconfig"

endif # USB_SUPPORT
```

## drivers/usb/host/Kconfig
```kconfig
# SPDX-License-Identifier: GPL-2.0

config USB_XHCI_MTK
	tristate "xHCI support for MediaTek SoCs"
	select MFD_SYSCON
	depends on (MIPS && SOC_MT7621) || ARCH_MEDIATEK || COMPILE_TEST
	help
	  Say 'Y' to enable the support for the xHCI host controller
	  found in MediaTek SoCs.
	  If unsure, say N.
```

## drivers/virt/Kconfig
```kconfig
# SPDX-License-Identifier: GPL-2.0-only
#
# Virtualization support drivers
#

if VIRT_DRIVERS

config DEVICE_MODULES_VMGENID
	tristate "Virtual Machine Generation ID driver"
	default y
	depends on ACPI
	help
	  Say Y here to use the hypervisor-provided Virtual Machine Generation ID
	  to reseed the RNG when the VM is cloned. This is highly recommended if
	  you intend to do any rollback / cloning / snapshotting of VMs.

	  Prefer Y to M so that this protection is activated very early.

config DEVICE_MODULES_FSL_HV_MANAGER
	tristate "Freescale hypervisor management driver"
	depends on FSL_SOC
	select EPAPR_PARAVIRT
	help
          The Freescale hypervisor management driver provides several services
	  to drivers and applications related to the Freescale hypervisor:

          1) An ioctl interface for querying and managing partitions.

          2) A file interface to reading incoming doorbells.

          3) An interrupt handler for shutting down the partition upon
	     receiving the shutdown doorbell from a manager partition.

          4) A kernel interface for receiving callbacks when a managed
	     partition shuts down.

source "drivers/virt/geniezone/Kconfig"

endif
```
