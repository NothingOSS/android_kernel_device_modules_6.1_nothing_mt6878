## drivers/gpu/drm/panel/Kconfig
```kconfig
# SPDX-License-Identifier: GPL-2.0-only

config DRM_PANEL_NOVATEK_NT35695B_VDO
	tristate "Novatek NT35695B AUO vdo mode panel"
	depends on OF
	depends on DRM_MIPI_DSI
	depends on BACKLIGHT_CLASS_DEVICE
	help
	  Say Y here if you want to enable support for NT35695B DPHY
	  vdo mode Full HD panel. The panel has a 1080x1920
	  resolution and uses 24-bits RGB per pixel. It provides a
	  MIPI DSI interface to host.

config DRM_PANEL_NOVATEK_NT36672A_VDO
	tristate "Novatek NT36672A FHD+ video mode panel"
	depends on OF
	depends on DRM_MIPI_DSI
	depends on BACKLIGHT_CLASS_DEVICE
	help
	  Say Y here if you want to enable support for NT36672A VDO
	  mode Full HD Plus panel. The panel has a 1080x2280 resolution
	  and uses 24-bits RGB per pixel. It provides a MIPI DSI interface
	  to host.

config DRM_PANEL_SAMSUNG_ANA6705_CMD
	tristate "ANA6705 amoled WQHD cmd mode panel"
	depends on OF
	depends on DRM_MIPI_DSI
	depends on BACKLIGHT_CLASS_DEVICE
	help
	  Say Y here if you want to enable support for ANA6705 DPHY
	  cmd mode WQHD panel. The panel has a 1440x3216
	  resolution and uses 24-bits RGB per pixel. It provides a
	  MIPI DSI interface to host.

config DRM_PANEL_SAMSUNG_ANA6705_CMD_FHDP
	tristate "ANA6705 amoled FHDP cmd mode panel"
	depends on OF
	depends on DRM_MIPI_DSI
	depends on BACKLIGHT_CLASS_DEVICE
	help
	  Say Y here if you want to enable support for ANA6705 DPHY
	  cmd mode FHDP panel. The panel has a 1440x3216
	  resolution and uses 24-bits RGB per pixel. It provides a
	  MIPI DSI interface to host.

config DRM_PANEL_HX_NT37701_DPHY_CMD
	tristate "NT37701 amoled dphy cmd mode panel"
	depends on OF
	depends on DRM_MIPI_DSI
	depends on BACKLIGHT_CLASS_DEVICE
	help
	  Say Y here if you want to enable support for NT37701 DPHY
	  cmd mode Full HD panel. The panel has a 1080x2400
	  resolution and uses 24-bits RGB per pixel. It provides a
	  MIPI DSI interface to host.

config DRM_PANEL_HX_NT37701_DPHY_CMD_120HZ
	tristate "NT37701 amoled dphy cmd mode panel"
	depends on OF
	depends on DRM_MIPI_DSI
	depends on BACKLIGHT_CLASS_DEVICE
	help
	  Say Y here if you want to enable support for NT37701 DPHY
	  cmd mode Full HD panel. The panel has a 1080x2400
	  resolution and uses 24-bits RGB per pixel. It provides a
	  MIPI DSI interface to host.

config DRM_PANEL_TRULY_TD4330_VDO
	tristate "TRULY  FHD+ video mode panel"
	depends on OF
	depends on DRM_MIPI_DSI
	depends on BACKLIGHT_CLASS_DEVICE
	help
	  Say Y here if you want to enable support for TRULY TD4330 VDO
	  mode Full HD Plus panel. The panel has a 1080x2280 resolution
	  and uses 24-bits RGB per pixel. It provides a MIPI DSI interface
	  to host.

config DRM_PANEL_TRULY_TD4330_CMD
	tristate "TRULY  FHD+ cmd mode panel"
	depends on OF
	depends on DRM_MIPI_DSI
	depends on BACKLIGHT_CLASS_DEVICE
	help
	  Say Y here if you want to enable support for TRULY TD4330 CMD
	  mode Full HD Plus panel. The panel has a 1080x2280 resolution
	  and uses 24-bits RGB per pixel. It provides a MIPI DSI interface
	  to host.

config DRM_PANEL_SAMSUNG_OP_CMD
	tristate "ANA6705 OP WQHD cmd mode panel"
	depends on OF
	depends on DRM_MIPI_DSI
	depends on BACKLIGHT_CLASS_DEVICE
	help
	  Say Y here if you want to enable support for ANA6705 DPHY
	  cmd mode WQHD panel. The panel has a 1440x3216
	  resolution and uses 24-bits RGB per pixel. It provides a
	  MIPI DSI interface to host.

config DRM_PANEL_SAMSUNG_OP_CMD_MSYNC2
	tristate "ANA6705 OP WQHD cmd msync2 mode panel"
	depends on OF
	depends on DRM_MIPI_DSI
	depends on BACKLIGHT_CLASS_DEVICE
	help
	  Say Y here if you want to enable support for ANA6705 DPHY
	  cmd mode WQHD panel. The panel has a 1440x3216
	  resolution and uses 24-bits RGB per pixel. It provides a
	  MIPI DSI interface to host.

config DRM_PANEL_TRULY_FT8756_VDO
	tristate "TRULY FHD+ vdo mode panel"
	depends on OF
	depends on DRM_MIPI_DSI
	depends on BACKLIGHT_CLASS_DEVICE
	help
	  Say Y here if you want to enable support for TRULY FT8756 VDO
	  mode Full HD Plus panel. The panel has a 1080x2300 resolution
	  and uses 24-bits RGB per pixel. It provides a MIPI DSI interface
	  to host.

config DRM_PANEL_ALPHA_JDI_NT36672C_CPHY_VDO
	tristate "ALPHA JDI FHD+ CPHY vdo mode panel"
	depends on OF
	depends on DRM_MIPI_DSI
	depends on BACKLIGHT_CLASS_DEVICE
	help
	  Say Y here if you want to enable support for ALPHA JDI NT36672C
	  CPHY vdo mode Full HD Plus panel. The panel has a 1080x2400
	  resolution and uses 24-bits RGB per pixel. It provides a
	  MIPI DSI interface to host.

config DRM_PANEL_SC_NT36672C_VDO_120HZ
	tristate "SC FHD+ vdo mode 120 HZ panel"
	depends on OF
	depends on DRM_MIPI_DSI
	depends on BACKLIGHT_CLASS_DEVICE
	help
	  Say Y here if you want to enable support for SC DPHY
	  vdo mode Full HD Plus 120HZ panel. The panel has a 1080x2400
	  resolution and uses 24-bits RGB per pixel. It provides a
	  MIPI DSI interface to host.

config DRM_PANEL_TIANMA_R66451_CMD_120HZ
	tristate "TIANMA  FHD+ cmd mode panel"
	depends on OF
	depends on DRM_MIPI_DSI
	depends on BACKLIGHT_CLASS_DEVICE
	help
	  Say Y here if you want to enable support for TIANMA R66451 CMD
	  mode 120HZ Full HD Plus panel. The panel has a 1080x2340 resolution
	  and uses 24-bits RGB per pixel. It provides a MIPI DSI interface
	  to host.

config DRM_PANEL_TIANMA_R66451_CMD_120HZ_WA
	tristate "TIANMA R66451 FHD+ cmd mode panel"
	depends on OF
	depends on DRM_MIPI_DSI
	depends on BACKLIGHT_CLASS_DEVICE
	help
	  Say Y here if you want to enable support for TIANMA R66451 CMD
	  mode 120HZ Full HD Plus panel. The panel has a 1080x2340 resolution
	  and uses 24-bits RGB per pixel. It provides a MIPI DSI interface
	  to host.

config DRM_PANEL_TIANMA_NT36672E_VDO_120HZ_HFP
	tristate "TIANMA FHD+ vdo mode 120 HZ HFP panel"
	depends on OF
	depends on DRM_MIPI_DSI
	depends on BACKLIGHT_CLASS_DEVICE
	help
	  Say Y here if you want to enable support for TIANMA DPHY
	  vdo mode HFP Full HD Plus 120HZ panel. The panel has a 1080x2408
	  resolution and uses 24-bits RGB per pixel. It provides a
	  MIPI DSI interface to host.

config DRM_PANEL_ALPHA_JDI_NT36672E_CPHY_VDO
	tristate "ALPHA JDI FHD+ CPHY vdo mode panel"
	depends on OF
	depends on DRM_MIPI_DSI
	depends on BACKLIGHT_CLASS_DEVICE
	help
	  Say Y here if you want to enable support for ALPHA JDI NT36672E
	  CPHY vdo mode Full HD Plus panel. The panel has a 1080x2400
	  resolution and uses 24-bits RGB per pixel. It provides a
	  MIPI DSI interface to host.

config DRM_PANEL_ALPHA_JDI_NT36672E_VDO_120HZ
	tristate "ALPHA JDI FHD+ DPHY vdo mode 120HZ panel"
	depends on OF
	depends on DRM_MIPI_DSI
	depends on BACKLIGHT_CLASS_DEVICE
	help
	  Say Y here if you want to enable support for ALPHA JDI NT36672E
	  DPHY vdo mode Full HD Plus 120HZ panel. The panel has a 1080x2400
	  resolution and uses 24-bits RGB per pixel. It provides a
	  MIPI DSI interface to host.

config DRM_PANEL_ALPHA_JDI_NT36672E_VDO_144HZ
	tristate "ALPHA JDI FHD+ DPHY vdo mode 144HZ panel"
	depends on OF
	depends on DRM_MIPI_DSI
	depends on BACKLIGHT_CLASS_DEVICE
	help
	  Say Y here if you want to enable support for ALPHA JDI NT36672E
	  DPHY vdo mode Full HD Plus 144HZ panel. The panel has a 1080x2400
	  resolution and uses 24-bits RGB per pixel. It provides a
	  MIPI DSI interface to host.

config DRM_PANEL_ALPHA_JDI_NT36672E_VDO_60HZ
	tristate "ALPHA JDI FHD+ DPHY vdo mode 60HZ panel"
	depends on OF
	depends on DRM_MIPI_DSI
	depends on BACKLIGHT_CLASS_DEVICE
	help
	  Say Y here if you want to enable support for ALPHA JDI NT36672E
	  DPHY vdo mode Full HD Plus 60HZ panel. The panel has a 1080x2400
	  resolution and uses 24-bits RGB per pixel. It provides a
	  MIPI DSI interface to host.

config DRM_PANEL_ALPHA_JDI_NT36672E_VDO_120HZ_HFP
	tristate "ALPHA JDI FHD+ DPHY vdo mode 120HZ hfp panel"
	depends on OF
	depends on DRM_MIPI_DSI
	depends on BACKLIGHT_CLASS_DEVICE
	help
	  Say Y here if you want to enable support for ALPHA JDI NT36672E
	  DPHY vdo mode Full HD Plus 120HZ hfp panel. The panel has a 1080x2400
	  resolution and uses 24-bits RGB per pixel. It provides a
	  MIPI DSI interface to host.

config DRM_PANEL_ALPHA_JDI_NT36672E_VDO_144HZ_HFP
	tristate "ALPHA JDI FHD+ DPHY vdo mode 144HZ hfp panel"
	depends on OF
	depends on DRM_MIPI_DSI
	depends on BACKLIGHT_CLASS_DEVICE
	help
	  Say Y here if you want to enable support for ALPHA JDI NT36672E
	  DPHY vdo mode Full HD Plus 144HZ hfp panel. The panel has a 1080x2400
	  resolution and uses 24-bits RGB per pixel. It provides a
	  MIPI DSI interface to host.

config DRM_PANEL_TRULY_NT35595_CMD
	tristate "TRULY  FHD+ cmd mode panel"
	depends on OF
	depends on DRM_MIPI_DSI
	depends on BACKLIGHT_CLASS_DEVICE
	help
	  Say Y here if you want to enable support for TRULY nt35595 CMD
	  mode Full HD Plus panel. The panel has a 1080x1920 resolution
	  and uses 24-bits RGB per pixel. It provides a MIPI DSI interface
	  to host.

config DRM_PANEL_NT37801_MSYNC2_RTE
	tristate "nt37801 fhdplus and wqhd dphy 120hz panel"
	depends on OF
	depends on DRM_MIPI_DSI
	depends on BACKLIGHT_CLASS_DEVICE
	help
	  Say Y here if you want to enable support for nt37801 fhdplus and
	  wqhd cmd panel. The panel has a 1080x2400 or 1440x3200 resolution
	  and uses 24-bits RGB per pixel. It provides a MIPI DSI
	  interface to host.

config DRM_PANEL_SAMSUNG_S68FC01_VDO_AOD
	tristate "samsung s68fc01 fhdp vdo aod panel"
	depends on OF
	depends on DRM_MIPI_DSI
	depends on BACKLIGHT_CLASS_DEVICE
	help
	  Say Y here if you want to enable support for samsung s68fc01
	  fhdp vdo aod panel. The panel has a 1080x2340 resolution
	  and uses 24-bits RGB per pixel. It provides a MIPI DSI
	  interface to host.

config DRM_PANEL_ALPHA_SAMSUNG_S6E3HAE_CMD_120HZ
	tristate "s6e3hae wqhd dphy 120hz panel"
	depends on OF
	depends on DRM_MIPI_DSI
	depends on BACKLIGHT_CLASS_DEVICE
	help
	  Say Y here if you want to enable support for samsung, s63shae
	  wqhd cmd panel. The panel has a 1440x3200 resolution
	  and uses 24-bits RGB per pixel. It provides a MIPI DSI
	  interface to host.

config DRM_PANEL_NT37801_CMD_FHD
	tristate "NT37801 cmd fhd mode panel"
	depends on OF
	depends on DRM_MIPI_DSI
	depends on BACKLIGHT_CLASS_DEVICE
	help
	  Say Y here if you want to enable support for NT37801 CMD FHD
	  cmd mode Full HD panel. The panel has a 1080x2400
	  resolution and uses 24-bits RGB per pixel. It provides a
	  MIPI DSI interface to host.

config DRM_PANEL_NT37801_CMD_LTPO
	tristate "nt37801 fhdplus and wqhd dphy 120hz panel"
	depends on OF
	depends on DRM_MIPI_DSI
	depends on BACKLIGHT_CLASS_DEVICE
	help
	  Say Y here if you want to enable support for nt37801 fhdplus and
	  wqhd cmd panel. The panel has a 1080x2400 or 1440x3200 resolution
	  and uses 24-bits RGB per pixel. It provides a MIPI DSI
	  interface to host.

config DRM_PANEL_NT37801_CMD_120HZ
	tristate "nt37801 fhdplus and wqhd dphy 120hz panel"
	depends on OF
	depends on DRM_MIPI_DSI
	depends on BACKLIGHT_CLASS_DEVICE
	help
	  Say Y here if you want to enable support for nt37801 fhdplus and
	  wqhd cmd panel. The panel has a 1080x2400 or 1440x3200 resolution
	  and uses 24-bits RGB per pixel. It provides a MIPI DSI
	  interface to host.

config DRM_PANEL_NT37801_CMD_SPR
	tristate "nt37801 fhdplus and wqhd dphy spr panel"
	depends on OF
	depends on DRM_MIPI_DSI
	depends on BACKLIGHT_CLASS_DEVICE
	help
	  Say Y here if you want to enable support for nt37801 fhdplus and
	  wqhd cmd panel. The panel has a 1080x2400 or 1440x3200 resolution
	  and uses 24-bits RGB per pixel. It provides a MIPI DSI
	  interface to host.

config DRM_PANEL_L12A_42_02_0A_DSC_CMD
	tristate "L12A 42 02 0A DSC cmd mode panel"
	depends on OF
	depends on DRM_MIPI_DSI
	depends on BACKLIGHT_CLASS_DEVICE
	help
	  Say Y here if you want to enable support for ALPHA JDI NT36672E
	  CPHY vdo mode Full HD Plus panel. The panel has a 1080x2400
	  resolution and uses 24-bits RGB per pixel. It provides a
	  MIPI DSI interface to host.

config DRM_MEDIATEK_PANEL
	tristate "drm panel common driver"
	depends on OF
	depends on DRM_MIPI_DSI
	depends on BACKLIGHT_CLASS_DEVICE
	help
	  Say Y here if you want to enable support for panel common driver.
	  support C-PHY and D-PHY, support HD, FHD resolution,
	  support CMD and VDO mode, support high frame rate.
	  and uses 24-bits RGB per pixel. It provides a MIPI DSI interface
	  to host.

config DRM_PANEL_NT37705_ALPHA_CMD
	tristate "mt6985 nt37705-alpha cmd panel"
	depends on OF
	depends on DRM_MIPI_DSI
	depends on BACKLIGHT_CLASS_DEVICE
	help
	  Say Y here if you want to enable support for mt6985 nt37705-alpha
	  fhd cmd aod panel. The panel has a 1260x2800 resolution
	  and uses 24-bits RGB per pixel. It provides a MIPI DSI
	  interface to host.

config DRM_TD2204_WQHD_AMB678ZY01_S6E3HC3_CMD
	tristate "mt6985 wqhd amb678zy01-s6e3hc3 cmd panel"
	depends on OF
	depends on DRM_MIPI_DSI
	depends on BACKLIGHT_CLASS_DEVICE
	help
	  Say Y here if you want to enable support for mt6985 amb678zy01-s6e3hc3
	  wqhd cmd aod panel. The panel has a 1440x3200 resolution
	  and uses 24-bits RGB per pixel. It provides a MIPI DSI
	  interface to host.
```

## drivers/input/touchscreen/FT3519/Kconfig
```kconfig
#
# Focaltech Touchscreen driver configuration
#

config TOUCHSCREEN_FT3519_I2C
    tristate "Focaltech Touchscreen"
    default m
    help
      Say Y here if you have Focaltech touch panel.
      If unsure, say N.
```

## drivers/iommu/Kconfig
```kconfig
# SPDX-License-Identifier: GPL-2.0-only

if IOMMU_SUPPORT

config DEVICE_MODULES_ARM_SMMU_V3
	tristate "ARM Ltd. System MMU Version 3 (SMMUv3) Support"
	depends on ARM64
	select IOMMU_API
	select IOMMU_IO_PGTABLE_LPAE
	select GENERIC_MSI_IRQ_DOMAIN
	help
	  Support for implementations of the ARM System MMU architecture
	  version 3 providing translation support to a PCIe root complex.

	  Say Y here if your system includes an IOMMU device implementing
	  the ARM SMMUv3 architecture.

config DEVICE_MODULES_MTK_IOMMU
	tristate "MediaTek IOMMU Support"
	depends on ARM || ARM64
	depends on ARCH_MEDIATEK || COMPILE_TEST
	select ARM_DMA_USE_IOMMU
	select IOMMU_API
	select IOMMU_IO_PGTABLE_ARMV7S
	select MEMORY
	select DEVICE_MODULES_MTK_SMI
	help
	  Support for the M4U on certain Mediatek SOCs. M4U is MultiMedia
	  Memory Management Unit. This option enables remapping of DMA memory
	  accesses for the multimedia subsystem.

	  If unsure, say N here.

config DEVICE_MODULES_MTK_SMMU_V3_PMU
	tristate "MediaTek SMMUV3 PMU Support"
	depends on DEVICE_MODULES_ARM_SMMU_V3
	help
	  Support for the SMMU v3 PMU on mediatek SOCs.
	  PMU is Performance Monitor Unit, can use to monitor SMMU TBU or
	  TCU performance.

	  If unsure, say N here.

endif # IOMMU_SUPPORT
```

## drivers/memory/Kconfig
```kconfig
# SPDX-License-Identifier: GPL-2.0-only

config DEVICE_MODULES_MTK_SMI
	tristate "MediaTek SoC Memory Controller driver" if COMPILE_TEST
	depends on ARCH_MEDIATEK || COMPILE_TEST
	help
	  This driver is for the Memory Controller module in MediaTek SoCs,
	  mainly help enable/disable iommu and control the power domain and
	  clocks for each local arbiter.

source "$(KCONFIG_EXT_PREFIX)drivers/memory/mediatek/Kconfig"
```

## drivers/misc/Kconfig
```kconfig
# SPDX-License-Identifier: GPL-2.0-only

source "drivers/misc/mediatek/Kconfig"
source "drivers/misc/haptic/Kconfig"
```

## drivers/misc/haptic/Kconfig
```kconfig
#
# ICS_HAPTIC_DRV Driver
#

config HAPTIC_DRV
	tristate "HAPTIC_DRV driver"
	default m
	depends on I2C
	help
	  Say Y here if you have AAC/ICS RT6010 haptic controller
	  chip in your system.
	  If unsure, say N.
	  To compile this driver as a module, choose M here: the
	  module will be called aac_haptic_drv.
```
