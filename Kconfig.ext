## Kconfig.ext
```kconfig
# SPDX-License-Identifier: GPL-2.0

source "$(KCONFIG_EXT_PREFIX)drivers/memory/Kconfig"

source "$(KCONFIG_EXT_PREFIX)drivers/iio/adc/Kconfig"

source "$(KCONFIG_EXT_PREFIX)drivers/mfd/Kconfig"

source "$(KCONFIG_EXT_PREFIX)drivers/nvmem/Kconfig"

source "$(KCONFIG_EXT_PREFIX)drivers/dma/mediatek/Kconfig"

source "$(KCONFIG_EXT_PREFIX)drivers/scsi/ufs/Kconfig"

source "$(KCONFIG_EXT_PREFIX)drivers/char/Kconfig"

source "$(KCONFIG_EXT_PREFIX)drivers/clk/mediatek/Kconfig"

source "$(KCONFIG_EXT_PREFIX)drivers/clocksource/Kconfig"

source "$(KCONFIG_EXT_PREFIX)drivers/cpufreq/Kconfig"

source "$(KCONFIG_EXT_PREFIX)drivers/soc/mediatek/Kconfig"

source "$(KCONFIG_EXT_PREFIX)drivers/watchdog/Kconfig"

source "$(KCONFIG_EXT_PREFIX)drivers/dma-buf/heaps/Kconfig"

source "$(KCONFIG_EXT_PREFIX)drivers/regulator/Kconfig"

source "$(KCONFIG_EXT_PREFIX)drivers/leds/Kconfig"

source "$(KCONFIG_EXT_PREFIX)drivers/pinctrl/mediatek/Kconfig"

source "$(KCONFIG_EXT_PREFIX)drivers/power/supply/Kconfig"

source "$(KCONFIG_EXT_PREFIX)drivers/rtc/Kconfig"

source "$(KCONFIG_EXT_PREFIX)drivers/remoteproc/Kconfig"

source "$(KCONFIG_EXT_PREFIX)drivers/rpmsg/Kconfig"

source "$(KCONFIG_EXT_PREFIX)drivers/input/keyboard/Kconfig"

source "$(KCONFIG_EXT_PREFIX)drivers/phy/mediatek/Kconfig"

source "$(KCONFIG_EXT_PREFIX)drivers/thermal/mediatek/Kconfig"

source "$(KCONFIG_EXT_PREFIX)drivers/spmi/Kconfig"

source "$(KCONFIG_EXT_PREFIX)drivers/tty/serial/8250/Kconfig"

source "$(KCONFIG_EXT_PREFIX)drivers/reset/Kconfig"

source "$(KCONFIG_EXT_PREFIX)drivers/mailbox/Kconfig"

source "$(KCONFIG_EXT_PREFIX)drivers/interconnect/Kconfig"

source "$(KCONFIG_EXT_PREFIX)drivers/i2c/busses/Kconfig"

source "$(KCONFIG_EXT_PREFIX)drivers/pwm/Kconfig"

source "$(KCONFIG_EXT_PREFIX)drivers/spi/Kconfig"

source "$(KCONFIG_EXT_PREFIX)drivers/iommu/Kconfig"

source "$(KCONFIG_EXT_PREFIX)drivers/tee/Kconfig"

source "$(KCONFIG_EXT_PREFIX)drivers/mmc/host/Kconfig"

source "$(KCONFIG_EXT_PREFIX)drivers/gpu/drm/mediatek/Kconfig"

source "$(KCONFIG_EXT_PREFIX)drivers/input/touchscreen/Kconfig"

source "$(KCONFIG_EXT_PREFIX)drivers/gpu/drm/panel/Kconfig"

source "$(KCONFIG_EXT_PREFIX)drivers/gpu/mediatek/Kconfig"

source "$(KCONFIG_EXT_PREFIX)drivers/media/platform/Kconfig"

source "$(KCONFIG_EXT_PREFIX)drivers/usb/Kconfig"

source "$(KCONFIG_EXT_PREFIX)drivers/devfreq/Kconfig"

source "$(KCONFIG_EXT_PREFIX)drivers/misc/mediatek/Kconfig"

source "$(KCONFIG_EXT_PREFIX)sound/soc/codecs/Kconfig"

source "$(KCONFIG_EXT_PREFIX)sound/soc/mediatek/Kconfig"
```

## drivers/chino-e/Kconfig
```kconfig
#
# OEM device bootinfo configuration
#

source "$(KCONFIG_EXT_PREFIX)drivers/chino-e/hwinfo/Kconfig"
```

## drivers/chino-e/hwinfo/Kconfig
```kconfig
#
# OEM device bootinfo configuration
#

config OEM_DEVINFO
    tristate "device boot info"
    help
	Say Y here if you want to enable device boot info.
	If unsure, say N.

config OEM_BOOTINFO
    tristate "bootinfo"
    help
	Say Y here if you want to enable bootinfo.
	If unsure, say N.

config OEM_BOARDID
    tristate "boardid"
    help
	Say Y here if you want to enable boardid.
	If unsure, say N.

config OEM_HWINFO
    tristate "hwinfo"
    help
	Say Y here if you want to enable hwinfo.
	If unsure, say N.
```

## drivers/cpufreq/Kconfig.arm
```kconfig
# SPDX-License-Identifier: GPL-2.0-only
#
# ARM CPU Frequency scaling drivers
#

config ARM_MEDIATEK_CPUFREQ_HW
	tristate "MediaTek CPUFreq HW driver"
	depends on ARCH_MEDIATEK || COMPILE_TEST
	default m
	help
	  Support for the CPUFreq HW driver.
	  Some MediaTek chipsets have a HW engine to offload the steps
	  necessary for changing the frequency of the CPUs. Firmware loaded
	  in this engine exposes a programming interface to the OS.
	  The driver implements the cpufreq interface for this HW engine.
	  Say Y if you want to support CPUFreq HW.
```

## drivers/dma-buf/heaps/Kconfig
```kconfig
config DEVICE_MODULES_DMABUF_HEAPS_DEFERRED_FREE
	tristate "DMA-BUF heaps deferred-free library"
	help
	  Choose this option to enable the DMA-BUF heaps deferred-free library.

config DEVICE_MODULES_DMABUF_HEAPS_PAGE_POOL
	tristate "DMA-BUF heaps page-pool library"
	help
	  Choose this option to enable the DMA-BUF heaps page-pool library.

config DEVICE_MODULES_DMABUF_HEAPS_SYSTEM
	tristate "DMA-BUF System Heap"
	depends on DMABUF_HEAPS && DEVICE_MODULES_DMABUF_HEAPS_DEFERRED_FREE && DEVICE_MODULES_DMABUF_HEAPS_PAGE_POOL
	help
	  Choose this option to enable the system dmabuf heap. The system heap
	  is backed by pages from the buddy allocator. If in doubt, say Y.

config DMABUF_HEAPS_DEBUG
	tristate "DMA-BUF debug Heap"
	depends on DEVICE_MODULES_DMABUF_HEAPS_SYSTEM
	help
	  Choose this option to enable the mtk debug heap.
	  This debug tool can be use to dump dmabuf usage for users
	  If you want use it, say Y if you are not using GKI
	  say m and add ko into your system for GKI.
```
