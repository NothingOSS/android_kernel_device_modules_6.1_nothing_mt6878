## drivers/input/touchscreen/EPH861/Kconfig
```kconfig
config TOUCHSCREEN_EPH861
	tristate "ESWIN EPH86XX touchscreen"
	depends on I2C || SPI_MASTER
	help
		Say Y here if you have a EPHTouch I2C or SPI for the built-in touchscreen.
		IF unsure, say N.
	choice
		prompt "ESWIN EPH86XXX BUS"
		default ESWIN_EPH861X_SPI
		config ESWIN_EPH861X_I2C
			bool "ESWIN_EPH861X_I2C" if I2C
			depends on TOUCHSCREEN_EPHTouch
		config ESWIN_EPH861X_SPI
			bool "ESWIN_EPH861X_SPI" if SPI_MASTER
			depends on TOUCHSCREEN_EPHTouch
	endchoice
```

## drivers/input/touchscreen/FT3683G/Kconfig
```kconfig
#
# Focaltech Touchscreen driver configuration
#

config TOUCHSCREEN_FT3683G_SPI
    tristate "Focaltech Touchscreen"
    default m
    help
      Say Y here if you have Focaltech touch panel.
      If unsure, say N.
```

## drivers/input/touchscreen/touchpanel_event_notify/Kconfig
```kconfig
#
# Focaltech Touchscreen driver configuration
#

config TOUCHPANEL_EVENT_NOTIFY
    tristate "touchpanel event notify"
    default m
    help
      Say Y here if you have touchpanel event notify.
      If unsure, say N.
```

## drivers/misc/haptic_sfdc/Kconfig
```kconfig
#
# ICS_HAPTIC_DRV Driver
#

config HAPTIC_SFDC_DRV
	tristate "ICS_HAPTIC_SFDC_DRV driver"
	default y
	depends on I2C
	help
	  Say Y here if you have AAC/ICS RT6010 haptic controller
	  chip in your system.
	  If unsure, say N.
	  To compile this driver as a module, choose M here: the
	  module will be called aac_haptic_drv.
```

## drivers/misc/mediatek/flashlight/v4l2/Kconfig
```kconfig
config MTK_VIDEO_LM3643
	tristate "LM3643 dual flash driver support"
	depends on I2C && VIDEO_DEV && MEDIA_CONTROLLER
	depends on MEDIA_CAMERA_SUPPORT
	select REGMAP_I2C
	help
	  This is a driver for the lm3643 dual flash controllers. It controls
	  flash, torch LEDs.

	  Say Y here if you want a flashlight driver IC LM3643.
	  Select this only if your board has this IC.
	  Say M here if you want to compile this driver as a module.

config MTK_VIDEO_LM3644
	tristate "LM3644 dual flash driver support"
	depends on I2C && VIDEO_DEV && MEDIA_CONTROLLER
	depends on MEDIA_CAMERA_SUPPORT
	select REGMAP_I2C
	help
	  This is a driver for the lm3644 dual flash controllers. It controls
	  flash, torch LEDs.

	  Say Y here if you want a flashlight driver IC LM3644.
	  Select this only if your board has this IC.
	  Say M here if you want to compile this driver as a module.

config MTK_VIDEO_OCP81375
	tristate "OCP81375 dual flash driver support"
	depends on I2C && VIDEO_DEV && MEDIA_CONTROLLER
	depends on MEDIA_CAMERA_SUPPORT
	select REGMAP_I2C
	help
	  This is a driver for the ocp81375 dual flash controllers. It controls
	  flash, torch LEDs.

	  Say Y here if you want a flashlight driver IC OCP81375.
	  Select this only if your board has this IC.
	  Say M here if you want to compile this driver as a module.

config MTK_VIDEO_SGM37864
	tristate "SGM37864 dual flash driver support"
	depends on I2C && VIDEO_DEV && MEDIA_CONTROLLER
	depends on MEDIA_CAMERA_SUPPORT
	select REGMAP_I2C
	help
	  This is a driver for the ocp81375 dual flash controllers. It controls
	  flash, torch LEDs.

	  Say Y here if you want a flashlight driver IC SGM37864.
	  Select this only if your board has this IC.
	  Say M here if you want to compile this driver as a module.

config MTK_VIDEO_SY7806
	tristate "SY7806 dual flash driver support"
	depends on I2C && VIDEO_DEV && MEDIA_CONTROLLER
	depends on MEDIA_CAMERA_SUPPORT
	select REGMAP_I2C
	help
	  This is a driver for the sy7806 dual flash controllers. It controls
	  flash, torch LEDs.

	  Say Y here if you want a flashlight driver IC SY7806.
	  Select this only if your board has this IC.
	  Say M here if you want to compile this driver as a module.
```
